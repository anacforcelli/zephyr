## boards/arm/pulga/Kconfig.board
```kconfig
# Copyright (c) 2023 LSI-TEC
# SPDX-License-Identifier: Apache-2.0

config BOARD_PULGA
	bool "Pulga Board"
	depends on SOC_NRF52840_QIAA
```

## boards/arm/pulga/Kconfig.defconfig
```kconfig
# nRF52840 DK NRF52840 board configuration

# Copyright (c) 2016 Nordic Semiconductor ASA
# SPDX-License-Identifier: Apache-2.0

if BOARD_PULGA

config BOARD
	default "pulga"

config BT_CTLR
	default BT

# TODO
# if sensors
# config_bme280
# config bmi160

endif # BOARD_PULGA
```

## boards/caninos/poodle-toy-v1/poodle-toy-v1_defconfig
```kconfig
CONFIG_GPIO=y
CONFIG_I2C=y
CONFIG_SPI=y
CONFIG_SERIAL=y
CONFIG_PWM=y
CONFIG_CONSOLE=y
CONFIG_UART_CONSOLE=y
CONFIG_LOG=y
CONFIG_LOG_MODE_MINIMAL=y
CONFIG_FLASH=y
CONFIG_SPI_NOR_SFDP_RUNTIME=y
```

## boards/caninos/puppy-testboard/Kconfig.defconfig
```kconfig
 
config HAS_FLASH_LOAD_OFFSET
    bool
    default y
    depends on BOOTLOADER_MCUBOOT && SOC_PUPPY
```

## boards/caninos/puppy-testboard/board.yml
```yaml
board:
  name: puppy-testboard
  full_name: Puppy Testboard
  vendor: caninos
  socs:
  - name: puppy_v1
```

## boards/shields/pulga_gps/Kconfig.shield
```kconfig
# Copyright (c) 2023 LSI-TEC
# SPDX-License-Identifier: Apache-2.0

config SHIELD_PULGA_GPS
	def_bool $(shields_list_contains,pulga_gps)
```

## boards/shields/pulga_lora/Kconfig.defconfig
```kconfig
# Copyright (c) 2023 LSI-TEC

# SPDX-License-Identifier: Apache-2.0

if SHIELD_PULGA_LORA

config LORA_SX127X # TODO should I set more stuff?
    default y


endif # SHIELD_PULGA_LORA
```

## drivers/interrupt_controller/Kconfig.puppy
```kconfig
# Kconfig.puppy - puppy IRQ/Event configuration option

config IRQ_PUPPY
	bool "Puppy IRQ/Event controller driver"
	default y
	depends on DT_HAS_CANINOS_PUPPY_EVENT_UNIT_ENABLED
	help
	  Enable driver for the Puppy IRQ/Event Unit controller.
```

## drivers/timer/Kconfig.puppy
```kconfig
config PUPPY_TIMER
    bool "Puppy timer driver"
    default y
    depends on SOC_SERIES_PUPPY
```

## dts/bindings/serial/caninos,puppy-uart.yaml
```yaml
description: >
    This is a representation of the Puppy UART node

include: [uart-controller.yaml, base.yaml]

compatible: "caninos,puppy-uart"

properties:

    reg:
      required: true
      description: mmio register space

    parity-en:
      type: boolean
      description: |
        Configures parity of adapter. false for none, true for even parity.

    uart-id:
      required: true
      type: int
      description: ID of the hardware UART instance 

    interrupts:
      required: true
      description: required interrupts
```

## soc/caninos/puppy/Kconfig.soc
```kconfig
config SOC_PUPPY
	bool "Pulpino SOC implementation"

config SOC
	default "puppy" if SOC_PUPPY
```

## soc/caninos/puppy_v1/Kconfig
```kconfig
config SOC_PUPPY_V1
	bool
	select RISCV
	select RISCV_PUPPY
	select ATOMIC_OPERATIONS_C
```

## soc/caninos/puppy_v1/Kconfig.defconfig
```kconfig
if SOC_PUPPY_V1

config SYS_CLOCK_HW_CYCLES_PER_SEC
	int
	default 20000000

config SYS_CLOCK_TICKS_PER_SEC
	int
	default 31250

config RISCV_SOC_CONTEXT_SAVE
	bool
	default y

config RISCV_SOC_INTERRUPT_INIT
	bool
	default y

config RISCV_HAS_CPU_IDLE
	bool
	default y

config RV_BOOT_HART
	int
	default 0

config RISCV_HART_MASK
	int
	default 1

config INCLUDE_RESET_VECTOR
	bool
	default y

config NUM_IRQS
	int
	default 32

config MP_MAX_NUM_CPUS
        default 1

#config ITCM_BASE_ADDRESS
#	hex
#	default	0x1c008000

#config ITCM_SIZE
#	hex
#	default 0x8000

#config DTCM_BASE_ADDRESS
#	hex
#	default 0x1c000000

#config DTCM_SIZE
#	hex
#	default 0x8000

endif # SOC_PUPPY
```

## soc/caninos/puppy_v2/Kconfig
```kconfig
config SOC_PUPPY_V2
	bool
	select RISCV
	select RISCV_PUPPY
	select ATOMIC_OPERATIONS_C
```
