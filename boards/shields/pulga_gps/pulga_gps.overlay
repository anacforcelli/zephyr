/*
 * Copyright (c) 2023 LSI-TEC
 *
 * SPDX-License-Identifier: Apache-2.0
 */

&uart1 {
	status = "okay";

	gps {
		// TODO compatible = "quectel,l86"; // whoops, there's no driver for that! (yet)
		current_speed = <9600>; // (default)
	};
};
