## boards/caninos/poodle-toy-v1/board.yml
```yaml
board:
  name: poodle-toy-v1
  full_name: Poodle Toy V1
  vendor: caninos
  socs:
    - name: puppy_v2
```

## boards/caninos/poodle-toy-v2/board.yml
```yaml
board:
  name: poodle-toy-v2
  full_name: Poodle Toy V2
  vendor: caninos
  socs:
    - name: puppy_v1
```
